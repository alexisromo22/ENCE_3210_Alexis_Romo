//HERE I AM ASSIGING VARIABLE NAMES TO EACH OF MY PINS
#define BUTTON1PIN   2 
#define BUTTON2PIN   3
#define REDLEDPIN    4   
#define GREENLEDPIN  5 
#define BLUELEDPIN   6  

//HERE WE ARE CREATING A VARIABLE THAT WILL DETERMINE WHICH OPERATION WILL
//BE PERFORMED BASED ON TIMES BUTTON IS PRESSED
int operationCounter = 0; 

//HERE WE ARE CREATING A VARIABLE THAT WILL KEEP COUNT OF HOW
//MANY TIMES THE BUTTON WAS PRESSED
int pressCount = 0;     

//HERE WE ARE CREATING AN ARRAY OF 10 ELEMENTS
int array1[10] = {1, 2, 3, 4, 5, 6, 7, 8, 9, 10};

//HERE WE ARE CREATING A SECOND ARRAY OF 10 ELEMENTS 
int array2[10] = {10, 9, 8, 7, 6, 5, 4, 3, 2, 1};

//HERE WE ARE CREATING AN EMPTY ARRAY WHERE THE NEW VALUES WILL BE ADDED
int resultArray[10] = {}; 

//HERE WE ARE CREATING A VARIABLE THAT WILL HELP DETERMINE WHEN THE BUTTON IS PRESSED USING BOOL
bool isCalculating = false; 

void setup() {
  //HERE WE ARE ASSIGING THE BUTTONS TO USE THE MACRO INPUT_PULLUP WHICH WILL
  //CAUSE THE BUTTON TO OUTPUT LOW (WHEN PRESSED) AND HIGH (WHEN NOT PRESSED)
  pinMode(BUTTON1PIN, INPUT_PULLUP);
  pinMode(BUTTON2PIN, INPUT_PULLUP);

  //HERE WE ARE ASSIGING THE LEDS AS OUTPUTS
  pinMode(REDLEDPIN, OUTPUT);
  pinMode(GREENLEDPIN, OUTPUT);
  pinMode(BLUELEDPIN, OUTPUT);

  //HERE WE ARE ASSIGING THE LEDS TO BEGIN TURNED OFF
  digitalWrite(REDLEDPIN, LOW);
  digitalWrite(GREENLEDPIN, LOW);
  digitalWrite(BLUELEDPIN, LOW);
  Serial.begin(9600); 
}

void loop() {
  // HERE WE ARE CHECKING IF THE FIRST BUTTON IS PRESSED
  if (digitalRead(BUTTON1PIN) == LOW) {
    //HERE WE ARE ADDING A DELAY TO AVIOD READING ANY DEBOUNCING
    delay(200); 
    //IF THE BUTTON WAS PRESSED THEN THE PRESSCOUNT WILL GO UP TO ONE VALUE
    //DEPENDING WHAT THE PRESS COUNT IS WILL DETERMINE WHICH IF STATEMENT THE PROGRAM WILL ENTER
    pressCount++;
    if (pressCount == 1) {
      //EACH IF STATEMENT HAS A CORRESPONDING OPERATION THAT 
      //IT WILL CARRY OUT, FOR EXAMPLE THE FIRST IF STATEMENT WILL 
      //DO THE ADDITION OPERATION
      //EACH OPERATION ALSO HAS A CERTAIN LED COLOR THAT WILL ALLOW THE USER TO KNOW WHICH OPERATER 
      //THEY ARE TELLING THE PROGRAM TO USE
      operationCounter = 1; // ADDITION
      digitalWrite(REDLEDPIN, HIGH);
      digitalWrite(GREENLEDPIN, LOW);
      digitalWrite(BLUELEDPIN, LOW);
    } else if (pressCount == 2) {
      operationCounter = 2; // SUBTRACTION
      digitalWrite(REDLEDPIN, LOW);
      digitalWrite(GREENLEDPIN, HIGH);
      digitalWrite(BLUELEDPIN, LOW);
    } else if (pressCount == 3) {
      operationCounter = 3; // MULTIPLICATION
      digitalWrite(REDLEDPIN, LOW);
      digitalWrite(GREENLEDPIN, LOW);
      digitalWrite(BLUELEDPIN, HIGH);
    }
    //IF MORE THAN 3 PRESSES ARE COUNTED THEN THE PRESSCOUNT WILL RESET AS THERE ARE ONLY 3 DIFFERENT CONDITIONS
    pressCount = pressCount % 3; 
  }

  // HERE WE ARE CHECKING IF THE SECOND BUTTON HAS BEEN PRESSED
  if (digitalRead(BUTTON2PIN) == LOW) {
    //HERE WE ARE ADDING A DELAY TO AVIOD READING ANY DEBOUNCING
    delay(200);

    //HERE IF !isCalculating THEN WE WILL BEGIN TO APPLY THE OPERATION TO THE ARRAYS
    if (!isCalculating) {
      applyOperation();
    }
  }
}

void applyOperation() {
  //HERE WE ARE TURNING OFF ALL LEDS IN ORDER FOR USER TO BE AWARE THAT
  //THE OPERATION HAS BEEN SELECTED AND PROGRAM IS COMPLETING THE OPERATION
  digitalWrite(REDLEDPIN, LOW);
  digitalWrite(GREENLEDPIN, LOW);
  digitalWrite(BLUELEDPIN, LOW);

  //HERE WE ARE CHANGING OUR BOOL TO TRUE
  isCalculating = true; 

  //HERE THE FOR LOOP WILL GO THRU ALL 10 ELEMENTS IN EACH ARRAY 
  //AND DO THE OPERATION PREVIOUSLY SELECTED TO EACH ELEMENT IN THE ARRAY IN THE ORDER EACH ELEMENT IS PLACED IN THE ARRAY
  for (int i = 0; i < 10; i++) {
    if (operationCounter == 1) {
      resultArray[i] = array1[i] + array2[i]; // ADDITION
    } else if (operationCounter == 2) {
      resultArray[i] = array1[i] - array2[i]; // SUBTRACTION
    } else if (operationCounter == 3) {
      resultArray[i] = array1[i] * array2[i]; // MULTIPLICATION
    }

    //HERE WE ARE PRINTING THE RESULTS AND ADDING THEM TO THE EMPTY ARRAY
    Serial.print("Result [");
    Serial.print(i);
    Serial.print("]: ");
    Serial.println(resultArray[i]);
  }



  //HERE WE ARE TURNING ON ALL THE LEDS TO SHOW USER THAT THE OPERATION IS COMPLETE
  digitalWrite(REDLEDPIN, HIGH);
  digitalWrite(GREENLEDPIN, HIGH);
  digitalWrite(BLUELEDPIN, HIGH);
  //HERE IS JUST A MINI DELAY TO KEEP THE LIGHTS FROM TURNING OFF TOO QUICKLY
  delay(2500); 
  digitalWrite(REDLEDPIN, LOW);
  digitalWrite(GREENLEDPIN, LOW);
  digitalWrite(BLUELEDPIN, LOW);

  //HERE WE ARE RESETTING OUR BOOL BACK TO FALSE BEFORE GOING BACK INTO THE FOR LOOP
  isCalculating = false;
}
